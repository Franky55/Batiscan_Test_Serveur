#include <SPI.h>
#include "esp_http_server.h"
#include "img_converters.h"
#include <WiFi.h>

#define PART_BOUNDARY "123456789000000000000987654321"

const char* ssid = "SM-G930W87541";
const char* password = "franky66";

static const char* _STREAM_CONTENT_TYPE = "multipart/x-mixed-replace;boundary=" PART_BOUNDARY;
static const char* _STREAM_BOUNDARY = "\r\n--" PART_BOUNDARY "\r\n";
static const char* _STREAM_PART = "Content-Type: image/jpeg\r\nContent-Length: %u\r\n\r\n";

uint8_t image_buffer[160*120*2] = {255, 216, 255, 224, 0, 16, 74, 70, 73, 70, 0, 1, 1,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 217, 

};

#define SPI_MISO 13
#define SPI_MOSI 11
#define SPI_CLK 12
#define INTERFACE_SPI_CS1 2


#define SPI_BUFFER_SIZE 64

unsigned char RAW_RX_buf[SPI_BUFFER_SIZE] {0};
unsigned char RAW_TX_buf[SPI_BUFFER_SIZE] = {'0','1','2','3','4','5','6','7','8','9',
'0','1','2','3','4','5','6','7','8','9',
'0','1','2','3','4','5','6','7','8','9',
'0','1','2','3','4','5','6','7','8','9',
'0','1','2','3','4','5','6','7','8','9',
'0','1','2','3','4','5','6','7','8','9',
'0','1','2','3'};



SPIClass interfaceSPI_Master(HSPI);


int interface_SPI_MASTER_Transaction(unsigned char * data, unsigned char * out, unsigned long size);

httpd_handle_t stream_httpd = NULL;


void send_image_buffer(uint8_t* buffer, httpd_req_t *req) {
  size_t buffer_len = 2598; // Assuming 16-bit color depth (RGB565 format)
  uint8_t* jpg_buf = NULL;
  size_t jpg_buf_len = 2598;
  char * part_buf[64];

  //bool jpeg_converted = fmt2jpg(buffer, buffer_len, 96, 96, PIXFORMAT_GRAYSCALE, 80, &jpg_buf, &jpg_buf_len);
  bool jpeg_converted = fmt2jpg(buffer, buffer_len, 160, 120, PIXFORMAT_JPEG, 80, &jpg_buf, &jpg_buf_len);
  if (!jpeg_converted) {
    Serial.println("JPEG conversion failed");
    return;
  }
  
    
  size_t hlen = snprintf((char *)part_buf, 64, _STREAM_PART, jpg_buf_len);
  httpd_resp_send_chunk(req, (const char *)part_buf, hlen);
  httpd_resp_send_chunk(req, (const char*)image_buffer, jpg_buf_len);
  httpd_resp_send_chunk(req, _STREAM_BOUNDARY, strlen(_STREAM_BOUNDARY));

  free(jpg_buf);
}



static esp_err_t stream_handler(httpd_req_t *req){
  camera_fb_t * fb = NULL;
  esp_err_t res = ESP_OK;
  size_t _jpg_buf_len = 2598;
  uint8_t * _jpg_buf = NULL;
  char * part_buf[64];

  res = httpd_resp_set_type(req, _STREAM_CONTENT_TYPE);
  if(res != ESP_OK){
    return res;
  }

  while(true){
    

        
    if(res == ESP_OK){
      
      size_t hlen = snprintf((char *)part_buf, 64, _STREAM_PART, _jpg_buf_len);
      res = httpd_resp_send_chunk(req, (const char *)part_buf, hlen);
    }
    if(res == ESP_OK){
      
      res = httpd_resp_send_chunk(req, (const char *)image_buffer, _jpg_buf_len);
    }
    if(res == ESP_OK){
      
      res = httpd_resp_send_chunk(req, _STREAM_BOUNDARY, strlen(_STREAM_BOUNDARY));
    }
    if(fb){
      
      esp_camera_fb_return(fb);
      fb = NULL;
      _jpg_buf = NULL;
    } else if(_jpg_buf){
      free(_jpg_buf);
      _jpg_buf = NULL;
    }
    if(res != ESP_OK){
      break;
    }
    //Serial.printf("MJPG: %uB\n",(uint32_t)(_jpg_buf_len));
  }
  return res;
}







void startCameraServer(){
  httpd_config_t config = HTTPD_DEFAULT_CONFIG();
  //config.max_resp_headers = 5;
  config.server_port = 80;

  httpd_uri_t index_uri = {
    .uri       = "/",
    .method    = HTTP_GET,
    .handler   = stream_handler,
    .user_ctx  = NULL
    
  };
  
  //Serial.printf("Starting web server on port: '%d'\n", config.server_port);
  if (httpd_start(&stream_httpd, &config) == ESP_OK) {
    httpd_register_uri_handler(stream_httpd, &index_uri);
  }
}

void setup() {
  // put your setup code here, to run once:
  pinMode(INTERFACE_SPI_CS1, OUTPUT);
  interfaceSPI_Master.begin(SPI_CLK, SPI_MISO, SPI_MOSI, INTERFACE_SPI_CS1);

  // Wi-Fi connection
  WiFi.begin(ssid, password);
  while (WiFi.status() != WL_CONNECTED) {
    delay(500);
    Serial.print(".");
  }
  delay(3000);
  Serial.println("");
  Serial.println("WiFi connected");
  
  Serial.print("Camera Stream Ready! Go to: http://");
  Serial.print(WiFi.localIP());
  
  // Start streaming web server
  startCameraServer();

}

void loop() {
  // put your main code here, to run repeatedly:
  interface_SPI_MASTER_Transaction(RAW_TX_buf, RAW_RX_buf, SPI_BUFFER_SIZE);
  delay(1000);
}


int interface_SPI_MASTER_Transaction(unsigned char * data, unsigned char * out, unsigned long size)
{
    digitalWrite(INTERFACE_SPI_CS1, LOW);  // Select the slave device
    interfaceSPI_Master.beginTransaction(SPISettings(1000000, MSBFIRST, SPI_MODE0));
    delayMicroseconds(10);

  // Send each character of the command string
//   for (size_t i = 0; i < size; i++) {
//     interfaceSPI_Master.transfer(data[i]);
//   }

    interfaceSPI_Master.transferBytes(data, out, size);
  
    interfaceSPI_Master.endTransaction();
    digitalWrite(INTERFACE_SPI_CS1, HIGH);  // Deselect the slave device
    // Serial.print("\n\nData Sending:     ");
    
    // interface_SPI_Master_Struct.Size = size;

    // for(int i = 0; i < size; i++)
    // {
    //     interface_SPI_Master_Struct.Transmit_SPI[i] = data[i]; 
    //     Serial.print((char)data[i]);
        
    // }


    Serial.print("\nData receiving:     ");

    for(int i = 0; i < size; i++)
    {
        //interface_SPI_Master_Struct.Received_SPI[i] = out[i]; 
        Serial.print((char)out[i]);
    }

    return 0;
}
